## boards/shields/caelum/Kconfig.defconfig
```kconfig
if SHIELD_CAELUM_LEFT || SHIELD_CALUM_RIGHT

config ZMK_KEYBOARD_NAME
    default "Caelum"

config ZMK_SPLIT_ROLE_CENTRAL
    default y

endif

if SHIELD_CAELUM_LEFT || SHIELD_CAELUM_RIGHT

config ZMK_SPLIT
    default y

endif
```

## boards/shields/caelum/Kconfig.shield
```kconfig
config SHIELD_CAELUM_LEFT
    def_bool $(shields_list_contains,caelum_left)
    
config SHIELD_CAELUM_RIGHT
    def_bool $(shields_list_contains,caelum_right)
```

## config/west.yml
```yaml
manifest:
  defaults:
    revision: v0.2
  remotes:
    - name: zmkfirmware
      url-base: https://github.com/zmkfirmware
    # Additional modules containing boards/shields/custom code can be listed here as well
    # See https://docs.zephyrproject.org/3.2.0/develop/west/manifest.html#projects
    # - name: caelum_module
    #   url-base: https://github.com/lindaazhao/
  projects:
    - name: zmk
      remote: zmkfirmware
      import: app/west.yml
    # - name: caelum-module
    #   remote: caelum_module
    #   revision: main
  self:
    path: config
```
